## drivers/misc/ti-serdes/Kconfig
```kconfig
#
# TI Serdes devices
#

config TI_VIDEO_SERDES
	tristate "TI Video SerDes"
	depends on I2C
	help
	  If you say yes here, you get support for the TI video serdes
	  TI-949, TI-948
```
